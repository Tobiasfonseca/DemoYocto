## conf/bblayers.conf
```bitbake
# POKY_BBLAYERS_CONF_VERSION is increased each time build/conf/bblayers.conf
# changes incompatibly
POKY_BBLAYERS_CONF_VERSION = "2"

BBPATH = "${TOPDIR}"
BBFILES ?= ""

BBLAYERS ?= " \
  /media/tobi/Yocto/DNN/poky/meta \
  /media/tobi/Yocto/DNN/poky/meta-poky \
  /media/tobi/Yocto/DNN/poky/meta-yocto-bsp \
  /media/tobi/Yocto/DNN/poky/meta-openembedded/meta-oe \
  /media/tobi/Yocto/DNN/poky/meta-openembedded/meta-python \
  /media/tobi/Yocto/DNN/poky/meta-openembedded/meta-multimedia \
  /media/tobi/Yocto/DNN/poky/meta-openembedded/meta-networking \
  /media/tobi/Yocto/DNN/poky/meta-raspberrypi \
  /media/tobi/Yocto/DNN/poky/meta-mylayer \
  "
```
